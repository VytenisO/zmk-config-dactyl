## config/boards/shields/dactyl_manuform_4x5/Kconfig.defconfig
```kconfig
if SHIELD_DACTYL_MANUFORM_4X5_LEFT

config ZMK_KEYBOARD_NAME
    default "Dactyl 4x5"

config ZMK_SPLIT_ROLE_CENTRAL
    default y

endif

if SHIELD_DACTYL_MANUFORM_4X5_LEFT || SHIELD_DACTYL_MANUFORM_4X5_RIGHT

config ZMK_SPLIT
    default y

endif
```
